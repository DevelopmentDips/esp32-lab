## main/Kconfig.projbuild
```kconfig
menu "Wi-Fi del laboratorio"

    config LAB_WIFI_SSID
        string "SSID"
        default ""

    config LAB_WIFI_PASSWORD
        string "Contrasena"
        default ""

endmenu
```
